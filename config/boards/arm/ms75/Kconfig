## config/boards/arm/ms75/Kconfig
```kconfig
config BOARD_ENABLE_DCDC
	bool "Enable DCDC mode"
	select SOC_DCDC_NRF52X
	default y
	depends on (BOARD_MS75_V1_LEFT || BOARD_MS75_V1_RIGHT) 

if ZMK_DISPLAY

menuconfig MS75_BONGO_CAT
    bool "Show WPM bongo cat"
    select ZMK_WPM
    select LV_USE_IMG
    select LV_USE_ANIMATION

if MS75_BONGO_CAT

config MS75_BONGO_CAT_IDLE_LIMIT
    int "Upper limit for WPM for showing idle animation"
    default 30

config MS75_BONGO_CAT_SLOW_LIMIT
    int "Upper limit for WPM for showing slow typing image"
    default 60

endif # MS75_BONGO_CAT


endif
```

## config/boards/arm/ms75/Kconfig.board
```kconfig
# SP56 board configuration

# Copyright (c) 2020 Eric Lau
# SPDX-License-Identifier: MIT

config BOARD_MS75_V1_LEFT
    bool "Mystery_75 Left"
    depends on SOC_NRF52840_QIAA
    select BOARD_MS75_V1_LEFT

config BOARD_MS75_V1_RIGHT
    bool "Mystery_75 Right"
    depends on SOC_NRF52840_QIAA
    select BOARD_MS75_V1_RIGHT
```

## config/boards/arm/ms75/Kconfig.defconfig
```kconfig
if BOARD_MS75_V1_RIGHT

config ZMK_KEYBOARD_NAME
	default "Ms75_Master"
config ZMK_SPLIT_ROLE_CENTRAL
	default y

endif # BOARD_MS75_V1_LEFT

if ZMK_DISPLAY
config I2C
	default y
	
config LVGL
    default y

config SSD1306
	default y

config SSD1306_REVERSE_MODE
	default y

config LV_Z_VDB_SIZE
	default 64

config LV_Z_DPI
	default 148

config LV_Z_BITS_PER_PIXEL
	default 1

choice LV_COLOR_DEPTH
	default LV_COLOR_DEPTH_1
endchoice

endif # ZMK_DISPLAY

if BOARD_MS75_V1_LEFT

config ZMK_KEYBOARD_NAME
	default "Mystery_75"

endif # ZMK_DISPLAY


if BOARD_MS75_V1_LEFT || BOARD_MS75_V1_RIGHT

config BOARD
	default "MS75"

config ZMK_SPLIT
	default y

config BT_CTLR
	default BT


if USB

config USB_NRFX
	default y

config USB_DEVICE_STACK
	default y

endif # USB

endif # BOARD_MS75_V1_LEFT || BOARD_MS75_V1_RIGHT
```

## config/boards/arm/ms75/ms75_v1_right_defconfig
```kconfig
CONFIG_SOC_SERIES_NRF52X=y
CONFIG_SOC_NRF52840_QIAA=y
CONFIG_BOARD_MS75_V1_RIGHT=y

# Enable MPU
CONFIG_ARM_MPU=y
CONFIG_PINCTRL=y

# enable GPIO
CONFIG_GPIO=y

# Enable both USB and BLE
CONFIG_ZMK_USB=y
CONFIG_ZMK_BLE=y

# Enable writing to flash
CONFIG_USE_DT_CODE_PARTITION=y
CONFIG_MPU_ALLOW_FLASH_WRITE=y
CONFIG_NVS=y
CONFIG_SETTINGS_NVS=y
CONFIG_FLASH=y
CONFIG_FLASH_PAGE_LAYOUT=y
CONFIG_FLASH_MAP=y
CONFIG_BUILD_OUTPUT_UF2=y
CONFIG_ZMK_HID_REPORT_TYPE_NKRO=y


# POLLING RATE ( 1ms )
CONFIG_USB_HID_POLL_INTERVAL_MS=1

# Debounce
CONFIG_ZMK_KSCAN_DEBOUNCE_PRESS_MS=3
CONFIG_ZMK_KSCAN_DEBOUNCE_RELEASE_MS=3
CONFIG_ZMK_KSCAN_EVENT_QUEUE_SIZE=8

# encoder
CONFIG_EC11=y
CONFIG_EC11_TRIGGER_GLOBAL_THREAD=y

# Displays
CONFIG_ZMK_DISPLAY=y
CONFIG_ZMK_WIDGET_WPM_STATUS=y
CONFIG_ZMK_WIDGET_BATTERY_STATUS=y
CONFIG_ZMK_WIDGET_OUTPUT_STATUS=y
CONFIG_ZMK_WIDGET_LAYER_STATUS=y
CONFIG_ZMK_WIDGET_PERIPHERAL_STATUS=y
CONFIG_ZMK_WIDGET_BATTERY_STATUS_SHOW_PERCENTAGE=y

# Enable deep sleep support
CONFIG_ZMK_SLEEP=y
CONFIG_ZMK_IDLE_TIMEOUT=80000
CONFIG_ZMK_IDLE_SLEEP_TIMEOUT=600000

# Enable external crystal
CONFIG_CLOCK_CONTROL_NRF=y
CONFIG_CLOCK_CONTROL_NRF_K32SRC_RC=y

CONFIG_BT_CTLR_TX_PWR_PLUS_8=y

# Use the STRIP config specific to the LEDs you're using
CONFIG_ZMK_RGB_UNDERGLOW=y
CONFIG_WS2812_STRIP=y
CONFIG_ZMK_RGB_UNDERGLOW_HUE_START=160
CONFIG_ZMK_RGB_UNDERGLOW_EFF_START=3
CONFIG_ZMK_RGB_UNDERGLOW_EXT_POWER=n
```
